## lge/lge_board/Kconfig
```kconfig
#platform.team@lge.com	2011.01

config MACH_LGE_I_BOARD
       bool "LGE_I_BOARD"
       depends on ARCH_MSM8X60
       default n
       ---help---
         LGE I-project.

config LGE_QC_LCDC_LUT
	bool "Set initial Qualcomm LCDC lut"
	default n
	depends on MACH_LGE_I_BOARD
	help
	  Set initial Qualcomm LCDC Look Up Table.

config LGE_KCAL
	bool "Interface to calibrate LCD color temperature"
	default n
	depends on MACH_LGE_I_BOARD
	help
	  Interface to calibrate LCD color temperature

config LGE_KCAL_QLUT
	bool "Interface to calibrate LCD color temperature by QLUT"
	default n
	depends on MACH_LGE_I_BOARD && LGE_QC_LCDC_LUT && LGE_KCAL
	help
	  Interface to calibrate LCD color temperature by QLUT


choice
	prompt "LGE board type"
	default MACH_LGE_I_BOARD_ATNT

config MACH_LGE_IJB_BOARD_SKT
       bool "LGE_IJB_BOARD_SKT"
       depends on MACH_LGE_I_BOARD
       ---help---
         LGE IJB-project for SKT.

config MACH_LGE_IJB_BOARD_LGU
       bool "LGE_IJB_BOARD_LGU"
       depends on MACH_LGE_I_BOARD
       ---help---
         LGE IJB-project for LGU.

endchoice
```
